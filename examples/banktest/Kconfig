## examples/banktest/Kconfig
```kconfig
config EXAMPLES_BANKTEST
	tristate "LISA bank test: a task that mallocs, sleeps and reports its bank"
	default n
	---help---
		banktest [seconds] [bytes]: allocates bytes, sleeps, checks the
		allocation and prints where its stack and heap are - run several
		in the background to spread tasks over the second LISA chip's
		memory banks (CONFIG_LISA_TASK_BANKS).  bigtest is the same
		program with a 4 KB stack: a stack bank of its own and a heap of
		24 KB less the stack (CONFIG_LISA_TASK_OWN_BANK_STACK).

if EXAMPLES_BANKTEST

config EXAMPLES_BANKTEST_PROGNAME
	string "Program name"
	default "banktest"

config EXAMPLES_BANKTEST_PRIORITY
	int "banktest task priority"
	default 100

config EXAMPLES_BANKTEST_STACKSIZE
	int "banktest stack size"
	default DEFAULT_TASK_STACKSIZE

endif
```

## examples/lisasplash/Kconfig
```kconfig
#
# For a description of the syntax of this configuration file,
# see the file kconfig-language.txt in the NuttX tools repository.
#

config EXAMPLES_LISASPLASH
	tristate "NuttX on LISA splash screen (splash)"
	default n
	depends on NX && NX_BLOCKING && !NX_DISABLE_1BPP
	select NXFONTS
	select NXFONT_SANS17X23B
	select NXFONT_X11_MISC_FIXED_6X10
	---help---
		The "splash" command: a splash screen for NuttX on the LISA chip
		on Tiny Tapeout, through NX on a 1 bpp display (128x64): the Tiny
		Tapeout logo or Calvin, "NuttX" and "on LISA / Tiny / Tapeout".
		splash [tt|calvin] [seconds] - 0 seconds (the default) holds it
		until the task is killed.

if EXAMPLES_LISASPLASH

config EXAMPLES_LISASPLASH_PROGNAME
	string "Program name"
	default "splash"

config EXAMPLES_LISASPLASH_PRIORITY
	int "Task priority"
	default 100

config EXAMPLES_LISASPLASH_STACKSIZE
	int "Stack size"
	default DEFAULT_TASK_STACKSIZE

endif
```

## examples/oledtext/Kconfig
```kconfig
#
# For a description of the syntax of this configuration file,
# see the file kconfig-language.txt in the NuttX tools repository.
#

config EXAMPLES_OLEDTEXT
	tristate "Text on a monochrome framebuffer (oled)"
	default n
	depends on VIDEO_FB
	---help---
		The "oled" command: text in a built-in 5x7 font on a 1 bpp
		framebuffer (/dev/fb0, an SSD1306 / SSD1309 OLED through the LCD
		framebuffer): a line per argument, one line replaced (-l), double
		size (-b), clear (-c).  Only the rows it changed are sent.

if EXAMPLES_OLEDTEXT

config EXAMPLES_OLEDTEXT_PROGNAME
	string "Program name"
	default "oled"

config EXAMPLES_OLEDTEXT_DEVPATH
	string "Framebuffer device"
	default "/dev/fb0"

config EXAMPLES_OLEDTEXT_PRIORITY
	int "Task priority"
	default 100

config EXAMPLES_OLEDTEXT_STACKSIZE
	int "Stack size"
	default DEFAULT_TASK_STACKSIZE

endif
```
